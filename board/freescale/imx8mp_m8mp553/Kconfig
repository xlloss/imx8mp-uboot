## board/freescale/imx8mp_m8mp553/Kconfig
```kconfig
if TARGET_IMX8MP_M8MP553

config SYS_BOARD
	default "imx8mp_m8mp553"

config SYS_VENDOR
	default "freescale"

config SYS_CONFIG_NAME
	default "imx8mp_m8mp553"

source "board/freescale/common/Kconfig"

endif
```

## board/freescale/imx8mp_trcnw400/Kconfig
```kconfig
if TARGET_IMX8MP_TRCNW400

config SYS_BOARD
	default "imx8mp_trcnw400"

config SYS_VENDOR
	default "freescale"

config SYS_CONFIG_NAME
	default "imx8mp_trcnw400"

source "board/freescale/common/Kconfig"

endif
```
